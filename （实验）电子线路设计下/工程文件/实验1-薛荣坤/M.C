/*祝你平安*/  
/*******************************************/
 
unsigned char mycount;
unsigned char code SONG[] ={      //祝你平安
0x26,0x20,0x20,0x20,0x20,0x20,0x26,0x10,0x20,0x10,0x20,0x80,0x26,0x20,0x30,0x20,
0x30,0x20,0x39,0x10,0x30,0x10,0x30,0x80,0x26,0x20,0x20,0x20,0x20,0x20,0x1c,0x20,
0x20,0x80,0x2b,0x20,0x26,0x20,0x20,0x20,0x2b,0x10,0x26,0x10,0x2b,0x80,0x26,0x20,
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0x20,0x10,0x2b,0x10,0x26,0x30,0x30,0x80,0x00};
 
void Time1_Init()
{
 TMOD = 0x01;
 IE   = 0x82;
 TH1  = 0xD8;
 TL1  = 0xEF;  //12MZ晶振，10ms
}
 
void Time1_Int() interrupt 3
{
 TH1 = 0xD8;
 TL1 = 0xEF;
 mycount++;   //长度加1
}

 
void Play_Song1(unsigned char i)
{
 unsigned char Temp1,Temp2;
 unsigned int Addr;
 mycount = 0;      //中断计数器清0
 Addr = i * 217;
 while(1)
 {
  Temp1 = SONG[Addr++];
     if ( Temp1 == 0xFF )          //休止符
     {
      TR1 = 0;
      Delay_ms(100);
     }
     else if ( Temp1 == 0x00 )   //歌曲结束符
     {
      return;
     }
     else
     {
      Temp2 = SONG[Addr++];
      TR1 = 1;
     while(1)
     {
       if(P4==0x00) P4=0xff;
			else P4=0x00;
       Delay_ms(Temp1);
       if ( Temp2 == mycount )
       {
        mycount = 0;
        break;
       }
      }
     }
 }
}
/*-------------------------------------------------
功能:主程序
-------------------------------------------------*/
void main()
{
 Time0_Init();   //定时器0中断初始化
 while(1)
 {
  Play_Song(0);  //播放
 }
}