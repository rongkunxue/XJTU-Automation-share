#include <stdio.h>
#include <string.h>

#include "c8051f020.h"
#include "lcd.h"
#include "led.h"
#include "xjtu_image.h"

#define SYSCLK    11059200

#define TIMER_PRESCALER            12  // Based on Timer CKCON settings

#define LED_TOGGLE_RATE            100 // LED toggle rate in milliseconds    1ms
                                       // if LED_TOGGLE_RATE = 1, the LED will
                                       // be on for 1 millisecond and off for
                                       // 1 millisecond

// There are SYSCLK/TIMER_PRESCALER timer ticks per second, so
// SYSCLK/TIMER_PRESCALER/1000 timer ticks per millisecond.
#define TIMER_TICKS_PER_MS  SYSCLK/TIMER_PRESCALER/1000

// Note: LED_TOGGLE_RATE*TIMER_TICKS_PER_MS should not exceed 65535 (0xFFFF)
// for the 16-bit timer

#define AUX1     TIMER_TICKS_PER_MS*LED_TOGGLE_RATE
#define AUX2     -AUX1
#define AUX3     AUX2&0x00FF
#define AUX4     ((AUX2&0xFF00)>>8)

#define TIMER0_RELOAD_HIGH       AUX4  // Reload value for Timer0 high byte
#define TIMER0_RELOAD_LOW        AUX3  // Reload value for Timer0 low byte


sbit INT1 = P0^3; //0的时候按键没用


unsigned int Time_num; //全局计时用
unsigned int flag=0;
unsigned int answerf=0;
unsigned int i=0;
unsigned int question=0;
unsigned int score=0;
unsigned int time=0;
int myflag;
uchar Temp[5];
uchar code str0[]="抑郁症初步测试";
uchar code str1[]="结果仅参考";
uchar code str2[]="小鱼出品";
uchar code str3[]="任意键跳过";


typedef struct{
	unsigned char que[16];
	unsigned char ansA[16];
	unsigned char ansB[16];
	unsigned char ansC[16];
}Question;

uchar code SONG_TONE[]={212,212,190,212,159,169,212,212,190,212,142,159,
212,212,106,126,159,169,190,119,119,126,159,142,159,0};
uchar code SONG_LONG[]={9,3,12,12,12,24,9,3,12,12,12,24,
9,3,12,12,12,12,12,9,3,12,12,12,24,0};


void PlayMusic()
{
uint i=0,j,k;
while(SONG_LONG[i]!=0||SONG_TONE[i]!=0){
    for(j=0;j<SONG_LONG[i]*20;j++){
    if(P4==0x00) P4=0xff;
		else P4=0x00;
    for(k=0;k<SONG_TONE[i]/3;k++);
		}
    Delay_ms(10);
    i++;
}
}


void Delay_xMs(unsigned int x)
{
    unsigned int i,j;
    for( i =0;i < x;i++ )
    {
        for( j =0;j<3;j++ );
    }
}


void Port_IO_Init()
{
	//set P4[1] to push_pull model
    P74OUT |= 0x01;
	//enable crossbar
    XBR2 |= 0x40;
    //close the alam P4.1
    P4 &= 0xfd;
	//uart1,int1
	XBR1 |= 0x14;
	XBR2 |= 0x44;
}

void Oscillator_Init()
{
    int i = 0;
    OSCXCN    = 0x67;
    for (i = 0; i < 3000; i++);  // Wait 1ms for initialization
    while ((OSCXCN & 0x80) == 0);
    OSCICN    = 0x08;
}

void Timer0_Init(void)
{
	
	TH0 = TIMER0_RELOAD_HIGH;           // Reinit Timer0 High register
	TL0 = TIMER0_RELOAD_LOW;
	ET0 = 1;                            // Timer0 interrupt enabled
	TMOD = 0x01;                        // 16-bit Mode Timer0
	//TCON |= 0x10;                        // Timer0 ON
}


void Interrupt_Init()
{
	//INT1
	//low level triggle
	IT1 = 0;
	//enable INT1
	EX1 = 1;
	//enable all interrupt
	EA = 1;
}

void Init_Device(void)
{
    //disable watchdog
    EA = 0;
    WDTCN = 0xde;
    WDTCN = 0xad;
    EA = 1;
	  //SYSCLK_Init();
    Oscillator_Init();
    Port_IO_Init();
	
		Interrupt_Init();
	
    LcdInit();
		LedInit();
}

void TimeCounter(int second){
	
	while(Time_num<second*100){
		TR0=1;
		LedDispNum();
		if(answerf==1){
			time+=Time_num;
			break;
		}
	}
	TR0=0;
	time+=Time_num;
	Time_num=0;
}

void ResDis(void){
	while(Time_num<5*100){
		TR0=1;
		ResDispNum();
	}
	TR0=0;
	Time_num=0;
}

//-----------------------------------------------------------------------------
// 主程序
//-----------------------------------------------------------------------------

void main()
{	
	int mm;

	Question Que[15];
	Init_Device();

	Timer0_Init();
	INT1 = 1;
	LcdInit();	

	strcpy(Que[0].que,"你想要打人吗");
	strcpy(Que[1].que,"人们对我不太友好");
	strcpy(Que[2].que,"不大想吃东西");
	strcpy(Que[3].que,"心里觉得苦闷");
	strcpy(Que[4].que,"总觉得自己不如人");
	strcpy(Que[5].que,"无法集中精力");
	strcpy(Que[6].que,"自觉情绪低沉");
	strcpy(Que[7].que,"任何事情觉得费力");
	strcpy(Que[8].que,"自己的生活是失败");
	strcpy(Que[9].que,"感到害怕");
	for (mm=0;mm<10;mm++){
	strcpy(Que[mm].ansA,"每周0--3次");
	strcpy(Que[mm].ansB,"每周4--6次");
	strcpy(Que[mm].ansC,"每周7 次以上");
}
	strcpy(Que[12].que,"你是乐观的孩子");
	strcpy(Que[12].ansA,"阳光并且积极");
	strcpy(Que[12].ansB,"困难不会打败你");
	strcpy(Que[12].ansC,"继续加油吧");

	strcpy(Que[13].que,"你是理智的孩子");
	strcpy(Que[13].ansA,"居安思危的处事");
	strcpy(Que[13].ansB,"谨慎的走每一步");
	strcpy(Que[13].ansC,"继续加油吧");

	strcpy(Que[14].que,"你应当寻求帮助");
	strcpy(Que[14].ansA,"医生或者心理辅导");
	strcpy(Que[14].ansB,"不用担心说出");
	strcpy(Que[14].ansC,"继续加油吧");
	
	ImageShow( xjtu_image2);
	Delay_ms(3000);
	LcdInit();
  	WriteStr(0, 0, str0);
  	WriteStr(1, 0, str1);
  	WriteStr(2, 0, str2);
	WriteStr(3, 0, str3);
	Delay_ms(3000);
	LcdInit();
	//开机动画
	score=0;
	flag=0;
	Time_num=0;
	time=0;
	while(question<10){
			LcdInit();
			WriteStr(0, 0, Que[question].que);
			WriteStr(1, 0, Que[question].ansA);
			WriteStr(2, 0, Que[question].ansB);
			WriteStr(3, 0, Que[question].ansC);
		
			P4=0xff;
			Delay_ms(100);
			P4=0x00;
			//计时开始提示音
			TimeCounter(5);
			P4=0xff;
			Delay_ms(100);
			P4=0x00;
			//计时结束
			if(flag==1){
				score+=0;
				LcdInit();
				ImageShow(xjtu_image1);
				Delay_ms(50);
			}
			if (flag==2){
				score+=2;
				LcdInit();
				ImageShow(xjtu_image1);
				Delay_ms(50);
			}
			if (flag==3){
				score+=3;
					LcdInit();
					ImageShow(xjtu_image1);
					Delay_ms(50);
			}
			flag=0;
			answerf=0;
			//标志位重新置为0
			question++;
		}
		
			if(score<=5){
				LcdInit();
				WriteStr(0, 0, Que[12].que);
				WriteStr(1, 0, Que[12].ansA);
				WriteStr(2, 0, Que[12].ansB);
				WriteStr(3, 0, Que[12].ansC);
				P4=0x00;//关闭蜂鸣器
				PlayMusic();//播放音乐
				Delay_ms(3000);
			}
			if(score>5&&score<=20){
				LcdInit();
				WriteStr(0, 0, Que[13].que);
				WriteStr(1, 0, Que[13].ansA);
				WriteStr(2, 0, Que[13].ansB);
				WriteStr(3, 0, Que[13].ansC);
				P4=0x00;//关闭蜂鸣器
				PlayMusic();//播放音乐
				Delay_ms(3000);
			}
			if(score>20&&score<=30){
				LcdInit();
				WriteStr(0, 0, Que[14].que);
				WriteStr(1, 0, Que[14].ansA);
				WriteStr(2, 0, Que[14].ansB);
				WriteStr(3, 0, Que[14].ansC);
				P4=0x00;//关闭蜂鸣器
				PlayMusic();//播放音乐
				Delay_ms(3000);
			}
}

void INT1_ISR(void) interrupt 2
{
	Delay_ms(1);
	answerf=1;
	switch(P5){
		case 0xfb:    
				flag=1;
				break;		
		case 0xfd:   
				flag=2;
				break;
		case 0xfe:
				flag=3;
				break;
	}
}

void Timer0_ISR (void) interrupt 1
{
	TH0 = TIMER0_RELOAD_HIGH;           // Reinit Timer0 High register
	TL0 = TIMER0_RELOAD_LOW;
	Time_num++;
	if(Time_num >= 6000) Time_num = 0;
	
}


const unsigned char gImage_bingo[1024] = { /* 0X00,0X01,0X80,0X00,0X40,0X00, */
0X00,0X00,0X00,0X00,0X00,0X00,0X00,0X00,0X00,0X00,0X00,0X00,0X00,0X00,0X00,0X00,
0X00,0X00,0X00,0X00,0X00,0X00,0X00,0X00,0X00,0X00,0X00,0X00,0X00,0X00,0X00,0X00,
0X00,0X00,0X00,0X00,0X00,0X00,0X00,0X00,0X00,0X00,0X00,0X00,0X00,0X00,0X00,0X00,
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0X00,0X00,0X00,0X00,0X00,0X00,0X00,0X00,0X00,0X00,0X00,0X00,0X00,0X00,0X00,0X00,
};

const unsigned char gImage_wrong[1024] = { /* 0X00,0X01,0X80,0X00,0X40,0X00, */
0XFF,0XFF,0XFF,0XFF,0XFF,0XFF,0XFF,0XFF,0XFF,0XFF,0XFF,0XFF,0XFF,0XFF,0XFF,0XFF,
0XFF,0XFF,0XFF,0XFF,0XFF,0XFF,0XFF,0XFF,0XFF,0XFF,0XFF,0XFF,0XFF,0XFF,0XFF,0XFF,
0XFF,0XFF,0XFF,0XFF,0XFF,0XFF,0XFF,0XFF,0XFF,0XFF,0XFF,0XFF,0XFF,0XFF,0XFF,0XFF,
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0XFF,0XFF,0XFF,0XFF,0XFF,0XFF,0XFF,0XFF,0XFF,0XFF,0XFF,0XFF,0XFF,0XFF,0XFF,0XFF,
};

const unsigned char gImage_win[1024] = { /* 0X00,0X01,0X80,0X00,0X40,0X00, */
0X00,0X00,0X00,0X00,0X00,0X00,0X00,0X00,0X00,0X1F,0XFF,0X80,0X00,0X00,0X00,0X00,
0X00,0X00,0X00,0X00,0X00,0X00,0X00,0X00,0X7F,0XFF,0XFF,0XFF,0XC0,0X00,0X00,0X00,
0X00,0X00,0X00,0X00,0X00,0X00,0X00,0X1F,0XFF,0XFF,0XFF,0XFF,0XFF,0X00,0X00,0X00,
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0X00,0X00,0X00,0X00,0X00,0X7F,0XE0,0X00,0X00,0X00,0X00,0X00,0X00,0X00,0X00,0X00,
};

const unsigned char gImage_start[1024] = { /* 0X00,0X01,0X80,0X00,0X40,0X00, */
0X00,0X00,0X00,0X00,0X00,0X00,0X00,0X00,0X00,0X00,0X00,0X00,0X00,0X00,0X00,0X00,
0X00,0X00,0X00,0X00,0X00,0X00,0X00,0X00,0X00,0X00,0X00,0X00,0X00,0X00,0X00,0X00,
0X00,0X00,0X00,0X00,0X00,0X00,0X00,0X00,0X00,0X00,0X00,0X00,0X00,0X00,0X00,0X00,
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0X00,0X00,0X00,0X00,0X00,0X00,0X00,0X00,0X00,0X00,0X00,0X00,0X00,0X00,0X00,0X00,
};

